## config/west.yml
```yaml
manifest:
  defaults:
    revision: main
  remotes:
    - name: cormoran
      url-base: https://github.com/cormoran
    # 既存のリモートはそのまま維持
#manifest:
  remotes:
    - name: zmkfirmware
      url-base: https://github.com/zmkfirmware
      # Additional modules containing boards/shields/custom code can be listed here as well.
      # See:
      # - https://zmk.dev/docs/features/modules
      # - https://docs.zephyrproject.org/3.5.0/develop/west/manifest.html#projects
    - name: gpeye
      url-base: https://github.com/GPeye
 projects:
    # ZMK: DYA Studio 用カスタム RPC サブシステム付き cormoran fork
    - name: zmk
      remote: cormoran
      revision: v0.3-branch+dya
      import: app/west.yml

    # DYA Studio モジュール（すべて cormoran リポジトリ）
    - name: zmk-module-ble-management
      remote: cormoran
      revision: main
    - name: zmk-module-battery-history
      remote: cormoran
      revision: main
    - name: zmk-module-settings-rpc
      remote: cormoran
      revision: main
    - name: zmk-module-runtime-input-processor
      remote: cormoran
      revision: main

    # その他のモジュール（トラックボールドライバー、LED ウィジェット等）
    # ...
  self:
    path: config
    
 # projects:
  # - name: eyelash_sofle
   #   url: https://github.com/a741725193/zmk-sofle
    #  revision: refactor
    #- name: mario-peripheral-animation
    #  remote: gpeye
    #  revision: main 
    #- name: zmk
    #  remote: zmkfirmware
    #  revision: v0.3.0
    #  import: app/west.yml
 # self:
 #   path: config
```
